/dts-v1/;
/plugin/;

#include "dt-bindings/usb/pd.h"

/ {
	fragment@0 {
		target = <&usb_con>;

		__overlay__ {
			sink-pdos = <PDO_FIXED(5000, 3000, PDO_FIXED_USB_COMM)
				     PDO_FIXED(9000, 3000, PDO_FIXED_USB_COMM)
				     PDO_FIXED(12000, 3000, PDO_FIXED_USB_COMM)
				     PDO_FIXED(15000, 3000, PDO_FIXED_USB_COMM)
				     PDO_FIXED(20000, 3000, PDO_FIXED_USB_COMM)>;
		};
	};
};
